## Documentation/devicetree/bindings/regulator/adi,adp5055-regulator.yaml
```yaml
# SPDX-License-Identifier: (GPL-2.0 OR BSD-2-Clause)
%YAML 1.2
---
$id: http://devicetree.org/schemas/regulator/adi,adp5055-regulator.yaml#
$schema: http://devicetree.org/meta-schemas/core.yaml#

title: Analog Devices ADP5055 Triple Buck Regulator

maintainers:
  - Alexis Czezar Torreno <alexisczezar.torreno@analog.com>

description: |
  The ADP5055 combines three high performance buck regulators.
  The device enables direct connection to high input voltages
  up to 18 V with no preregulators.
  https://www.analog.com/media/en/technical-documentation/data-sheets/adp5055.pdf

properties:
  compatible:
    enum:
      - adi,adp5055

  reg:
    enum:
      - 0x70
      - 0x71

  adi,tset-8x:
    description:
      Setting time used by the device. This is changed via soldering
      specific resistor values on the CFG2 pin. If property is absent,
      the setting time Tset defaults to 2.6ms. If present, Tset is
      increased 8 times to 20.8ms.
    type: boolean

  adi,hw-en-array-gpios:
    description:
      Asserted during driver probe. Each array entry acts as the
      hardware enable for channels 0-2. Should be marked 0 for active
      low. Requires all three channels to be initialized. Not adding
      the property turns the system to a software only enable mode.
    maxItems: 3

  adi,ocp-blanking:
    description:
      If present, the over current protection
      blanking (OCP) for all channels is on.
    type: boolean

  adi,delay-power-good:
    description:
      Configures delay timer of the power good (PWRGD) pin.
      Delay is based on Tset which can be 2.6 ms or 20.8 ms.
    type: boolean

  '#address-cells':
    const: 1

  '#size-cells':
    const: 0

patternProperties:
  "^channel@([0-2])$":
    type: object
    additionalProperties: false

    properties:
      reg:
        description: The channel number representing each buck converter.
        maximum: 2

      adi,power-saving-mode-ch:
        description:
          If present, enables power saving mode for
          individual channels.
        type: boolean

      adi,output-discharge-function-ch:
        description:
          If present, enable output discharge functionality
          for individual channels.
        type: boolean

      adi,disable-delay-ch:
        description:
          Configures the disable delay for each channel. Dependent on Tset.
        enum: [0ms, 5.2ms, 10.4ms, 15.6ms, 20.8ms, 26ms, 31.2ms, 36.4ms]
        default: 0ms

      adi,enable-delay-ch:
        description:
          Configures the disable delay for each channel. Dependent on Tset.
        enum: [0ms, 2.6ms, 5.2ms, 7.8ms, 10.4ms, 13ms, 15.6ms, 18.2ms]
        default: 0ms

      adi,dvs-limit-upper-ch-microvolt:
        description:
          Configure the allowable upper side limit of the
          voltage output of each channel in microvolt.
          Voltages are in 12mV steps, value is autoadjusted.
          Vout_high = Vout + DVS_upper_limit.
        minimum: 12000
        maximum: 192000
        default: 192000

      adi,dvs-limit-lower-ch-microvolt:
        description:
          Configure the allowable lower side limit of the
          voltage output of each channel in microvolt.
          Voltages are in 12mV steps, value is autoadjusted.
          Vout_low = Vout + DVS_lower_limit.
        minimum: -190500
        maximum: -10500
        default: -190500

      adi,fast-transient-ch:
        description:
          Configures the fast transient sensitivity for each channel.
          "none"    - No fast transient.
          "3G_1.5%" - 1.5% window with 3*350uA/V
          "5G_1.5%" - 1.5% window with 5*350uA/V
          "5G_2.5%" - 2.5% window with 5*350uA/V
        enum: [none, 3G_1.5%, 5G_1.5%, 5G_2.5%]
        default: 5G_2.5%

      adi,mask-power-good-ch:
        description:
          Masks or unmasks individual channels to the external
          PWRGD hardware pin.
        type: boolean

    required:
      - reg

allOf:
  - $ref: regulator.yaml#

  - if:
      properties:
        adi,tset-8x: true

    then:
      properties:
        adi,disable-delay-ch:
          enum: [0ms, 41.6ms, 83.2ms, 124.8ms, 166.4ms, 208ms, 249.6ms, 291.2ms]

        adi,enable-delay-ch:
          enum: [0ms, 20.8ms, 41.6ms, 62.4ms, 83.2ms, 104ms, 124.8ms, 145.6ms]

required:
  - compatible
  - reg

unevaluatedProperties: false

examples:
  - |
    i2c {
        #address-cells = <1>;
        #size-cells = <0>;

        regulator@70 {
            compatible = "adi,adp5055";
            reg = <0x70>;
            #address-cells = <1>;
            #size-cells = <0>;

            adi,tset-8x;
            adi,hw-en-array-gpios = <&gpio 17 0>,
                                    <&gpio 18 0>,
                                    <&gpio 19 0>;

            adi,ocp-blanking;
            adi,delay-power-good;

            channel@0 {
                reg = <0>;
                adi,power-saving-mode-ch;
                adi,output-discharge-function-ch;
                adi,disable-delay-ch = "0ms";
                adi,enable-delay-ch = "0ms";
                adi,dvs-limit-upper-ch = <192000>;
                adi,dvs-limit-lower-ch = <(-190500)>;
                adi,fast-transient-ch = "5G_2.5%";
                adi,mask-power-good-ch;
            };

            channel@1 {
                reg = <1>;
                adi,power-saving-mode-ch;
                adi,output-discharge-function-ch;
                adi,disable-delay-ch = "0ms";
                adi,enable-delay-ch = "0ms";
                adi,dvs-limit-upper-ch = <192000>;
                adi,dvs-limit-lower-ch = <(-190500)>;
                adi,fast-transient-ch = "5G_2.5%";
                adi,mask-power-good-ch;
            };

            channel@2 {
                reg = <2>;
                adi,power-saving-mode-ch;
                adi,output-discharge-function-ch;
                adi,disable-delay-ch = "0ms";
                adi,enable-delay-ch = "0ms";
                adi,dvs-limit-upper-ch = <192000>;
                adi,dvs-limit-lower-ch = <(-190500)>;
                adi,fast-transient-ch = "5G_2.5%";
                adi,mask-power-good-ch;
            };
        };
    };
```
